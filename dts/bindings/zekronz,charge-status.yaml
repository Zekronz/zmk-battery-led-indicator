## dts/bindings/zekronz,charge-status.yaml
```yaml
description: Charger status pins

compatible: "zekronz,charge-status"

properties:
  stat1-gpios:
    type: phandle-array
    required: true

  stat2-gpios:
    type: phandle-array
    required: true
```

## west.yml
```yaml
manifest:
  remotes:
    - name: Zekronz
      url-base: https://github.com/Zekronz
  projects:
    # Together with the above defined remote, this refers to a module located at
    # https://github.com/remote-name/repository-name
    - name: zmk-battery-led-indicator
      remote: Zekronz
      # This points to a west manifest file in the remote module for further imports
      import: west.yml
```
